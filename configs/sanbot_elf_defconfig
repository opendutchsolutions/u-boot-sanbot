## configs/sanbot_elf_defconfig
```kconfig
CONFIG_ARM=y
CONFIG_ARCH_SUNXI=y
CONFIG_DEFAULT_DEVICE_TREE="sun8i-a83t-sanbot"
CONFIG_SPL=y
CONFIG_MACH_SUN8I_A83T=y

CONFIG_VIDEO=y
CONFIG_VIDEO_BRIDGE=y
CONFIG_VIDEO_LCD_SSD2828=y
CONFIG_DM_PWM=y
CONFIG_BACKLIGHT_PWM=y
CONFIG_PWM_SUNXI=y
CONFIG_DRAM_CLK=480
CONFIG_DRAM_TYPE=7
CONFIG_DRAM_ZQ=15355
CONFIG_DRAM_ODT_EN=y


CONFIG_MMC_SUNXI_SLOT_EXTRA=2


CONFIG_AXP_GPIO=y


CONFIG_AXP_DCDC1_VOLT=3000  
CONFIG_AXP_DCDC2_VOLT=900   
CONFIG_AXP_DCDC3_VOLT=900   
CONFIG_AXP_DCDC4_VOLT=900   
CONFIG_AXP_DCDC5_VOLT=1200   
CONFIG_AXP_DCDC6_VOLT=900    


CONFIG_AXP_ALDO1_VOLT=1800 
CONFIG_AXP_ALDO2_VOLT=1800  
CONFIG_AXP_ALDO3_VOLT=3000   

CONFIG_AXP_DLDO1_VOLT=2800  
CONFIG_AXP_DLDO2_VOLT=3300   
CONFIG_AXP_DLDO4_VOLT=2800   

CONFIG_AXP_ELDO2_VOLT=1800 
CONFIG_AXP_ELDO3_VOLT=1200  

CONFIG_AXP_FLDO2_VOLT=900 
CONFIG_AXP_GPIO0_VOLT=3300   

CONFIG_AXP_SW_ON=y
CONFIG_REGULATOR_AXP_DRIVEVBUS=y  
CONFIG_REGULATOR_AXP_USB_POWER=y   

CONFIG_INITIAL_USB_SCAN_DELAY=500
CONFIG_USB_EHCI_HCD=y
CONFIG_USB_OHCI_HCD=y
CONFIG_USB_MUSB_HOST=y

CONFIG_CONSOLE_MUX=y

CONFIG_VIDEO_LCD_MODE="x:1920,y:1200,depth:18,pclk_khz:150000,le:28,ri:80,up:0,lo:16,hs:16,vs:8,sync:3,vmode:0"
CONFIG_VIDEO_LCD_BL_EN="PD29"    
CONFIG_VIDEO_LCD_BL_PWM="PD28"       
                                  
CONFIG_VIDEO_LCD_PANEL_MIPI_4_LANE_513_MBPS_VIA_SSD2828=y
CONFIG_VIDEO_LCD_SSD2828_TX_CLK=150
CONFIG_VIDEO_LCD_SSD2828_RESET="PE9"
CONFIG_VIDEO_LCD_SPI_SCLK="PE5"    
CONFIG_VIDEO_LCD_SPI_MOSI="PE6"      
CONFIG_VIDEO_LCD_SPI_CS="PE7"        
CONFIG_VIDEO_LCD_SPI_MISO=""         

CONFIG_ANDROID_BOOT_IMAGE=y
CONFIG_SYS_BOOTM_LEN=0x4000000
CONFIG_SETUP_MEMORY_TAGS=y
CONFIG_CMDLINE_TAG=y
CONFIG_INITRD_TAG=y
CONFIG_BOOTM_LINUX=y
CONFIG_CMD_ABOOTIMG=y
CONFIG_CMD_ADTIMG=y
```
